#ifndef TITLE_H
#define TITLE_H

// Title screen: the game's own playfield scrolls by behind the logo, and a small menu sits at the bottom.
// The logo is stored compressed (see logoImg / logoCol) and merged straight into the display buffer, so the
// playfield shows through the transparent parts around it.

#include "globals.h"
#include "playfield.h"

#define LOGO_W        90
#define LOGO_X        19          // centred
#define LOGO_PAGE     1           // top of the logo = row 8 (the logo is written to the buffer in whole pages)

// logo 90 x 32: white pixels only, 4 pages of 90 columns (the black outline and the transparent corners are both 0)
const unsigned char PROGMEM logoImg[] =
{
  0x00, 0x00, 0x00, 0x00, 0x00, 0x00, 0x00, 0x00, 0x7e, 0xfe, 0xfe, 0xfe, 0x78, 0xfe, 0x7e, 0x00,
  0xfe, 0xfe, 0xfe, 0xfe, 0x08, 0xfe, 0xfe, 0x00, 0x1e, 0xbe, 0xfe, 0xfe, 0x78, 0x3e, 0x1e, 0x00,
  0x00, 0xfe, 0xfe, 0xfe, 0xfe, 0xf2, 0xfe, 0x7c, 0x00, 0xf2, 0xf2, 0xfe, 0xfe, 0xfe, 0xf2, 0xf2,
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  0x41, 0x7f, 0x7f, 0x7f, 0x79, 0x7f, 0x3e, 0x00,
};

// per column: (transparent rows at the top << 3) | transparent rows at the bottom; everything between is opaque, white where logoImg has a pixel, black elsewhere
const unsigned char PROGMEM logoCol[] =
{
  0xc1, 0xb8, 0xb8, 0xb8, 0x50, 0x48, 0x40, 0x00, 0x00, 0x00, 0x00, 0x00, 0x00, 0x00, 0x00, 0x00,
  0x00, 0x00, 0x00, 0x00, 0x00, 0x00, 0x00, 0x00, 0x00, 0x00, 0x00, 0x00, 0x00, 0x00, 0x00, 0x00,
  0x00, 0x00, 0x00, 0x00, 0x01, 0x04, 0x04, 0x00, 0x00, 0x00, 0x00, 0x00, 0x00, 0x00, 0x00, 0x00,
  0x00, 0x00, 0x00, 0x00, 0x00, 0x00, 0x00, 0x00, 0x08, 0x00, 0x00, 0x01, 0x00, 0x00, 0x00, 0x00,
  0x00, 0x00, 0x00, 0x00, 0x00, 0x00, 0x00, 0x00, 0x00, 0x00, 0x00, 0x00, 0x00, 0x00, 0x00, 0x00,
  0x00, 0x08, 0x40, 0x40, 0x40, 0x40, 0xb8, 0xb8, 0xb8, 0xc1,
};

// the logo, written into the display buffer: only the opaque rows of every column are touched
void drawLogo()
{
  uint8_t *buf = arduboy.getBuffer();
  for (byte x = 0; x < LOGO_W; x++)
  {
    byte tb = pgm_read_byte(&logoCol[x]);
    int8_t top = tb >> 3, end = 32 - (tb & 7);             // opaque rows: top .. end-1
    for (byte p = 0; p < 4; p++)
    {
      int8_t lo = top - 8 * p, hi = end - 8 * p;           // the opaque rows inside this page
      if (hi <= 0 || lo >= 8) continue;
      if (lo < 0) lo = 0;
      if (hi > 8) hi = 8;
      byte m = (byte)(0xFF << lo) & (byte)(0xFF >> (8 - hi));
      byte *d = &buf[(LOGO_PAGE + p) * 128 + LOGO_X + x];
      *d = (*d & ~m) | (pgm_read_byte(&logoImg[p * LOGO_W + x]) & m);
    }
  }
}

// tiny 3 x 5 letters, only what the "SOON" box needs (bit 2 = left pixel)
const char PROGMEM glyphChars[] = "SON";
const unsigned char PROGMEM glyphs[3][5] = { {7,4,7,1,7}, {7,5,5,5,7}, {5,7,7,5,5} };

void drawGlyph(int16_t x, int16_t y, char ch, byte color)
{
  byte i = 0;
  while (i < 2 && pgm_read_byte(&glyphChars[i]) != ch) i++;
  for (byte r = 0; r < 5; r++)
  {
    byte bits = pgm_read_byte(&glyphs[i][r]);
    for (byte c = 0; c < 3; c++) if (bits & (4 >> c)) arduboy.drawPixel(x + c, y + r, color);
  }
}

// the four menu words INFO PLAY CONF JBOX as 30 x 8 buttons (plus-mask, one page, one frame each; menuSelection 0..3)
#define MENU_Y   52
const unsigned char PROGMEM menuWords[] =
{
  30, 8,
  // INFO
  0x00, 0xff, 0x72, 0xff, 0x72, 0xff, 0x7e, 0xff, 0x7e, 0xff, 0x7e, 0xff, 0x72, 0xff, 0x72, 0xff,
  0x0c, 0xff, 0x7e, 0xff, 0x7e, 0xff, 0x7e, 0xff, 0x04, 0xff, 0x08, 0xff, 0x7e, 0xff, 0x00, 0xff,
  0x7e, 0xff, 0x7e, 0xff, 0x7e, 0xff, 0x16, 0xff, 0x06, 0x3f, 0x06, 0x7f, 0x38, 0xff, 0x7e, 0xff,
  0x7e, 0xff, 0x72, 0xff, 0x72, 0xff, 0x7e, 0xff, 0x3c, 0xff, 0x00, 0x7e,
  // PLAY
  0x00, 0xff, 0x7e, 0xff, 0x7e, 0xff, 0x7e, 0xff, 0x7e, 0xff, 0x12, 0xff, 0x1e, 0x3f, 0x0c, 0xff,
  0x70, 0xff, 0x7e, 0xff, 0x7e, 0xff, 0x7e, 0xff, 0x60, 0xff, 0x60, 0xf0, 0x60, 0xf8, 0x10, 0xff,
  0x7a, 0xff, 0x7a, 0xff, 0x6a, 0xff, 0x6a, 0xff, 0x7e, 0xff, 0x3c, 0xff, 0x42, 0xff, 0x5e, 0xff,
  0x7e, 0xff, 0x7e, 0xff, 0x30, 0xff, 0x3e, 0x7f, 0x1e, 0x3f, 0x00, 0x3f,
  // CONF
  0x00, 0x7e, 0x3c, 0xff, 0x7e, 0xff, 0x7e, 0xff, 0x7e, 0xff, 0x76, 0xff, 0x76, 0xff, 0x30, 0xff,
  0x0c, 0xff, 0x7e, 0xff, 0x7e, 0xff, 0x72, 0xff, 0x72, 0xff, 0x7e, 0xff, 0x3c, 0xff, 0x42, 0xff,
  0x7e, 0xff, 0x7e, 0xff, 0x7e, 0xff, 0x04, 0xff, 0x08, 0xff, 0x7e, 0xff, 0x00, 0xff, 0x7e, 0xff,
  0x7e, 0xff, 0x7e, 0xff, 0x16, 0xff, 0x06, 0x3f, 0x06, 0x0f, 0x00, 0x0f,
  // JBOX
  0x00, 0x7c, 0x38, 0xff, 0x7a, 0xff, 0x72, 0xff, 0x7e, 0xff, 0x7e, 0xff, 0x7e, 0xff, 0x3e, 0xff,
  0x40, 0xff, 0x7e, 0xff, 0x7e, 0xff, 0x6a, 0xff, 0x6a, 0xff, 0x7e, 0xff, 0x34, 0xff, 0x08, 0xff,
  0x7c, 0xff, 0x7e, 0xff, 0x72, 0xff, 0x72, 0xff, 0x7e, 0xff, 0x3c, 0xff, 0x42, 0xff, 0x76, 0xff,
  0x7e, 0xff, 0x7e, 0xff, 0x1c, 0xff, 0x7e, 0xff, 0x76, 0xff, 0x00, 0xff,
};

// the selected button is drawn inverted: same shape, black and white swapped
void drawWord(int16_t x, int16_t y, byte item, bool inverted)
{
  if (!inverted) { sprites.drawPlusMask(x, y, menuWords, item); return; }
  const unsigned char *d = menuWords + 2 + (uint16_t)item * 60;
  for (byte c = 0; c < 30; c++)
  {
    byte img = pgm_read_byte(d++), mask = pgm_read_byte(d++);
    for (byte r = 0; r < 8; r++)
      if (mask & (1 << r)) arduboy.drawPixel(x + c, y + r, (img & (1 << r)) ? BLACK : WHITE);
  }
}

void drawMenu()
{
  for (byte i = 0; i < 4; i++) drawWord(1 + i * 32, MENU_Y, i, i == menuSelection);
}

// the world that scrolls by behind the title (no chicken)
bool    titleReady = false;
byte    titleSub = 0;

void titleWorld()
{
  scrollY = -32000;                                     // no dead zone behind the title screen
  if (!titleReady || (camY >> 3) > 3000)                // (re)build the world; also before the rows get too big for int16
  {
    worldInit();
    player.set();
    player.characteristics = 0;                         // no chicken
    camX = player.x; camY = player.y;
    titleSub = 0;
    titleReady = true;
  }
  titleSub += 6;                                        // 6/16 px per frame
  camY += titleSub >> 4;
  titleSub &= 15;
  int16_t cr = camY >> 3;
  extendWorld(cr);
  updateLanes(cr);
  drawGround();
  drawObjects();
}

void drawTitle()
{
  if (menuSelection > 3) menuSelection = 1;             // PLAY is pre-selected
  titleWorld();
  drawLogo();
  drawMenu();
}

// INFO, CONF and JBOX are not there yet: a small "SOON" box over the moving playfield
void drawSoon(byte item)
{
  titleWorld();
  arduboy.fillRect(46, 18, 36, 28, BLACK);
  arduboy.drawRect(47, 19, 34, 26, WHITE);
  drawWord(49, 22, item, false);
  drawGlyph(56, 35, 'S', WHITE); drawGlyph(60, 35, 'O', WHITE); drawGlyph(64, 35, 'O', WHITE); drawGlyph(68, 35, 'N', WHITE);
}

#endif
